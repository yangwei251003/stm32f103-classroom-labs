#include "stm32f10x.h"
#include "Delay.h"

//=====================OLED引脚配置=====================
#define OLED_SDA_PIN  GPIO_Pin_7
#define OLED_SCL_PIN  GPIO_Pin_6
#define OLED_PORT     GPIOB
#define OLED_ADDR     0x78    //黑屏就改成0x7A

#define OLED_SDA_H()  GPIO_SetBits(OLED_PORT,OLED_SDA_PIN)
#define OLED_SDA_L()  GPIO_ResetBits(OLED_PORT,OLED_SDA_PIN)
#define OLED_SCL_H()  GPIO_SetBits(OLED_PORT,OLED_SCL_PIN)
#define OLED_SCL_L()  GPIO_ResetBits(OLED_PORT,OLED_SCL_PIN)

//=====================I2C底层函数=====================
void OLED_I2C_Start(void)
{
    OLED_SDA_H();
    OLED_SCL_H();
    Delay_us(4);
    OLED_SDA_L();
    Delay_us(4);
    OLED_SCL_L();
}

void OLED_I2C_Stop(void)
{
    OLED_SDA_L();
    OLED_SCL_H();
    Delay_us(4);
    OLED_SDA_H();
    Delay_us(4);
}

u8 OLED_I2C_WaitAck(void)
{
    u8 ack = 0;
    OLED_SDA_H();
    OLED_SCL_H();
    Delay_us(4);
    while(GPIO_ReadInputDataBit(OLED_PORT,OLED_SDA_PIN))
    {
        ack++;
        if(ack > 250)
        {
            OLED_I2C_Stop();
            return 1;
        }
    }
    OLED_SCL_L();
    return 0;
}

void OLED_I2C_WriteByte(u8 dat)
{
    u8 i;
    for(i = 0; i < 8; i++)
    {
        OLED_SCL_L();
        Delay_us(2);
        if(dat & 0x80)
            OLED_SDA_H();
        else
            OLED_SDA_L();
        dat <<= 1;
        Delay_us(2);
        OLED_SCL_H();
        Delay_us(2);
    }
}

//发送命令
void OLED_Write_Cmd(u8 cmd)
{
    OLED_I2C_Start();
    OLED_I2C_WriteByte(OLED_ADDR << 1);
    OLED_I2C_WaitAck();
    OLED_I2C_WriteByte(0x00);
    OLED_I2C_WaitAck();
    OLED_I2C_WriteByte(cmd);
    OLED_I2C_WaitAck();
    OLED_I2C_Stop();
}

//发送显示数据
void OLED_Write_Data(u8 dat)
{
    OLED_I2C_Start();
    OLED_I2C_WriteByte(OLED_ADDR << 1);
    OLED_I2C_WaitAck();
    OLED_I2C_WriteByte(0x40);
    OLED_I2C_WaitAck();
    OLED_I2C_WriteByte(dat);
    OLED_I2C_WaitAck();
    OLED_I2C_Stop();
}

//设置光标坐标
void OLED_Set_Pos(u8 x, u8 y)
{
    OLED_Write_Cmd(0xb0 + y);
    OLED_Write_Cmd(((x & 0xf0) >> 4) | 0x10);
    OLED_Write_Cmd(x & 0x0f);
}

//全屏清屏
void OLED_Clear(void)
{
    u8 y, x;
    for(y = 0; y < 8; y++)
    {
        OLED_Write_Cmd(0xb0 + y);
        OLED_Write_Cmd(0x00);
        OLED_Write_Cmd(0x10);
        for(x = 0; x < 128; x++)
            OLED_Write_Data(0x00);
    }
}

//8*16数字字模 0~9
u8 num8x16[10][32] = {
//0
{0x00,0x00,0x7F,0xFC,0x40,0x04,0x40,0x04,0x40,0x04,0x40,0x04,0x7F,0xFC,0x00,0x00,
 0x00,0x00,0x7F,0xFC,0x40,0x04,0x40,0x04,0x40,0x04,0x40,0x04,0x7F,0xFC,0x00,0x00},
//1
{0x00,0x00,0x00,0x04,0x00,0x04,0x7F,0xFC,0x00,0x04,0x00,0x04,0x00,0x00,0x00,0x00,
 0x00,0x00,0x00,0x04,0x00,0x04,0x7F,0xFC,0x00,0x04,0x00,0x04,0x00,0x00,0x00,0x00},
//2
{0x00,0x00,0x7F,0xFC,0x40,0x04,0x40,0x04,0x40,0x04,0x40,0x04,0x40,0xFC,0x00,0x00,
 0x00,0x00,0x40,0x00,0x40,0x00,0x40,0x00,0x40,0x00,0x40,0x00,0x7F,0xFC,0x00,0x00},
//3
{0x00,0x00,0x7F,0xF8,0x40,0x08,0x40,0x08,0x40,0x08,0x40,0x08,0x7F,0xF8,0x00,0x00,
 0x00,0x00,0x40,0x00,0x40,0x00,0x40,0x00,0x40,0x00,0x40,0x00,0x7F,0xFC,0x00,0x00},
//4
{0x00,0x00,0x10,0x00,0x28,0x00,0x48,0x00,0x88,0x00,0x7F,0xFC,0x08,0x00,0x00,0x00,
 0x00,0x00,0x08,0x00,0x08,0x00,0x08,0x00,0x08,0x00,0x7F,0xFC,0x08,0x00,0x00,0x00},
//5
{0x00,0x00,0x7F,0xF8,0x08,0x08,0x08,0x08,0x08,0x08,0x08,0x08,0x78,0xF0,0x00,0x00,
 0x00,0x00,0x78,0x00,0x40,0x00,0x40,0x00,0x40,0x00,0x40,0x00,0x7F,0xFC,0x00,0x00},
//6
{0x00,0x00,0x7F,0xFC,0x08,0x04,0x08,0x04,0x08,0x04,0x08,0x04,0x78,0xF8,0x00,0x00,
 0x00,0x00,0x7F,0xFC,0x40,0x04,0x40,0x04,0x40,0x04,0x40,0x04,0x7F,0xFC,0x00,0x00},
//7
{0x00,0x00,0x7F,0xFC,0x40,0x04,0x40,0x04,0x40,0x04,0x40,0x04,0x40,0x04,0x00,0x00,
 0x00,0x00,0x40,0x00,0x40,0x00,0x40,0x00,0x40,0x00,0x40,0x00,0x7F,0xFC,0x00,0x00},
//8
{0x00,0x00,0x7F,0xFC,0x40,0x04,0x40,0x04,0x40,0x04,0x40,0x04,0x7F,0xFC,0x00,0x00,
 0x00,0x00,0x7F,0xFC,0x40,0x04,0x40,0x04,0x40,0x04,0x40,0x04,0x7F,0xFC,0x00,0x00},
//9
{0x00,0x00,0x7F,0xFC,0x40,0x04,0x40,0x04,0x40,0x04,0x40,0x04,0x7F,0xFC,0x00,0x00,
 0x00,0x00,0x40,0x00,0x40,0x00,0x40,0x00,0x40,0x00,0x40,0x00,0x7F,0xFC,0x00,0x00}
};

//显示单个数字 x横坐标 y页号 num数字0~9
void OLED_ShowNum(u8 x, u8 y, u8 num)
{
    u8 t;
    OLED_Set_Pos(x, y);
    for(t = 0; t < 16; t++)
        OLED_Write_Data(num8x16[num][t]);
    OLED_Set_Pos(x, y+1);
    for(t = 16; t < 32; t++)
        OLED_Write_Data(num8x16[num][t]);
}

//OLED硬件初始化
void OLED_Init(void)
{
    GPIO_InitTypeDef GPIO_InitStruct;
    RCC_APB2PeriphClockCmd(RCC_APB2Periph_GPIOB, ENABLE);

    GPIO_InitStruct.GPIO_Pin = OLED_SDA_PIN | OLED_SCL_PIN;
    GPIO_InitStruct.GPIO_Mode = GPIO_Mode_Out_PP;
    GPIO_InitStruct.GPIO_Speed = GPIO_Speed_50MHz;
    GPIO_Init(OLED_PORT, &GPIO_InitStruct);

    OLED_SDA_H();
    OLED_SCL_H();
    Delay_ms(100);

    OLED_Write_Cmd(0xAE); //关闭显示
    OLED_Write_Cmd(0xD5); //时钟分频
    OLED_Write_Cmd(0x80);
    OLED_Write_Cmd(0xA8); //多路复用
    OLED_Write_Cmd(0x3F);
    OLED_Write_Cmd(0xD3); //显示偏移
    OLED_Write_Cmd(0x00);
    OLED_Write_Cmd(0x40); //起始行
    OLED_Write_Cmd(0x8D); //电荷泵
    OLED_Write_Cmd(0x14);
    OLED_Write_Cmd(0x20); //内存模式
    OLED_Write_Cmd(0x02);
    OLED_Write_Cmd(0xA1); //段重映射
    OLED_Write_Cmd(0xC8); //COM扫描方向
    OLED_Write_Cmd(0xDA); //COM硬件配置
    OLED_Write_Cmd(0x12);
    OLED_Write_Cmd(0x81); //对比度
    OLED_Write_Cmd(0xCF);
    OLED_Write_Cmd(0xD9); //预充电
    OLED_Write_Cmd(0xF1);
    OLED_Write_Cmd(0xDB); //VCOMH
    OLED_Write_Cmd(0x40);
    OLED_Write_Cmd(0xA4); //跟随RAM内容
    OLED_Write_Cmd(0xA6); //正常显示
    OLED_Write_Cmd(0xAF); //开启OLED

    OLED_Clear();
}

int main(void)
{
    Delay_Init();
    OLED_Init();
    OLED_Clear();

    //屏幕第二行，依次显示 2 0 2 6
    OLED_ShowNum(20, 2, 2);
    OLED_ShowNum(32, 2, 0);
    OLED_ShowNum(44, 2, 2);
    OLED_ShowNum(56, 2, 6);

    while(1)
    {
        //循环内不需要操作，静态显示
    }
}